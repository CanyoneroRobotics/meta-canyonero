## conf/layer.conf
```bitbake
# We have a conf and classes directory, append to BBPATH
BBPATH .= ":${LAYERDIR}"

# We have a recipes directory, add to BBFILES
BBFILES += "${LAYERDIR}/recipes-*/*/*.bb ${LAYERDIR}/recipes-*/*/*.bbappend"

BBFILE_COLLECTIONS += "meta-canyonero"
BBFILE_PATTERN_meta-canyonero := "^${LAYERDIR}/"
BBFILE_PRIORITY_meta-canyonero = "12"

LICENSE_PATH += "${LAYERDIR}/licenses"
```
